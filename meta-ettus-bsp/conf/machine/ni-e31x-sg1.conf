## meta-ettus-bsp/conf/machine/ni-e31x-sg1.conf
```bitbake
#@TYPE: Machine
#@Name: NI Ettus Research E31x SG1
#@DESCRIPTION: Machine configuration for the NI Ettus Research E31x SG1

require conf/machine/ni-e31x.inc

DTB_FILES = "zynq-ni-e31x-sg1.dtb"
UBOOT_MACHINE = "ni_e31x_sg1_defconfig"
```

## meta-ettus-bsp/conf/machine/ni-e31x-sg3.conf
```bitbake
#@TYPE: Machine
#@Name: NI Ettus Research E31x SG3
#@DESCRIPTION: Machine configuration for the NI Ettus Research E31x SG3

require conf/machine/ni-e31x.inc

DTB_FILES = "zynq-ni-e31x-sg3.dtb"
UBOOT_MACHINE = "ni_e31x_sg3_defconfig"
```

## meta-ettus-bsp/conf/machine/ni-neon-rev1.conf
```bitbake
#@TYPE: Machine
#@Name: Ettus Research Neon.
#@DESCRIPTION: Machine configuration for the Ettus Research Neon Rev1 Software Radio.

require conf/machine/ni-neon.inc

MACHINEOVERRIDES .= ":ni-neon-rev1"

KERNEL_DEVICETREE:ni-neon-rev1 = "\
                                  zynq-ni-neon-rev1.dtb \
                                 "


UBOOT_MACHINE:ni-neon-rev1 = "ni_neon_rev1_defconfig"

MACHINE_FEATURES:append:ni-neon-rev1 = " tpm"
```

## meta-ettus-bsp/conf/machine/ni-neon-rev2.conf
```bitbake
#@TYPE: Machine
#@Name: Ettus Research Neon.
#@DESCRIPTION: Machine configuration for the Ettus Research Neon Rev2 Software Radio.

require conf/machine/ni-neon.inc

MACHINEOVERRIDES .= ":ni-neon-rev2"

KERNEL_DEVICETREE:ni-neon-rev2 = "\
                                  zynq-ni-neon-rev1.dtb \
                                 "


UBOOT_MACHINE:ni-neon-rev2 = "ni_neon_rev2_defconfig"

MACHINE_FEATURES:append:ni-neon-rev2 = " tpm"
```

## meta-ettus-bsp/conf/machine/ni-sulfur-rev3.conf
```bitbake
#@TYPE: Machine
#@Name: Ettus Research Sulfur.
#@DESCRIPTION: Machine configuration for the Ettus Research Sulfur Rev2 Software Radio.

require conf/machine/ni-sulfur.inc

KERNEL_DEVICETREE = "zynq-ni-sulfur-rev3.dtb zynq-ni-eiscat.dtb zynq-ni-magnesium.dtb"
UBOOT_MACHINE = "ni_sulfur_rev3_defconfig"
```

## meta-mender-titanium/conf/machine/ni-titanium-mender.inc
```bitbake
MACHINEOVERRIDES =. "ni-titanium-mender:"

MENDER_FEATURES_ENABLE:append:ni-titanium-mender = " mender-uboot mender-image \
    mender-image-sd mender-systemd mender-client-install"
MENDER_FEATURES_DISABLE:append:ni-titanium-mender = " mender-grub mender-image-uefi"

IMAGE_FSTYPES:remove:ni-titanium-mender = "wic wic.bmap"

PREFERRED_VERSION_pn-mender-client = "2.%"
PREFERRED_VERSION_pn-mender-artifact = "3.%"
PREFERRED_VERSION_pn-mender-artifact-native = "3.%"

IMAGE_INSTALL:append = " mender-client-migrate-configuration"
PACKAGECONFIG:remove = "split-mender-config"
MENDER_PERSISTENT_CONFIGURATION_VARS = "RootfsPartA RootfsPartB"
# MENDER_ARTIFACT_EXTRA_ARGS:append = " -v 2"

MENDER_DATA_PART_FSTAB_OPTS ?= "defaults,noatime"
MENDER_BOOT_PART_FSTAB_OPTS ?= "defaults,noatime"
```
